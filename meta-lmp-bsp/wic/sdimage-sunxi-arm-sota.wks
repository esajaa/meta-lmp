## meta-lmp-bsp/wic/sdimage-sunxi-arm-sota.wks
```
# short-description: Create OTA-enabled SD card image with a boot partition
# long-description: Creates a partitioned SD card image with OSTree
# physical sysroot as a payload. Boot files are located in the
# first vfat partition.
#
# The disk layout used is:
#  - -------------- --------- -------------
# | | SPL + u-boot |  boot   |    rootfs   |
#  - -------------- --------- -------------
# ^ ^              ^         ^
# | |              |         |
# 0 8kiB           2048kiB   52MiB + rootfs + IMAGE_EXTRA_SPACE (default 10MiB)
#
part SPL --source rawcopy --sourceparams="file=u-boot-sunxi-with-spl.bin" --ondisk mmcblk --no-table --align 8
part /boot --source bootimg-partition --ondisk mmcblk --fstype=vfat --label boot --active --align 2048 --size 50
part / --source otaimage --ondisk mmcblk --fstype=ext4 --align 4096

bootloader --ptable msdos
```
